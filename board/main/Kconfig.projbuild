## board/main/Kconfig.projbuild
```kconfig
menu "Board Configuration"

    config BOARD_SERIAL_CMD
        bool "Enable serial JSON command handler (for GUI tools)"
        default n
        help
            Enables a UART JSON command listener that allows the
            board_monitor.py GUI tool to scan I2C slots and trigger
            ESP-NOW sends. Enable this for debug/development builds.

endmenu
```

## board/sdkconfig.defaults.debug
```kconfig
CONFIG_IDF_TARGET="esp32s3"
CONFIG_LOG_DEFAULT_LEVEL_DEBUG=y
CONFIG_LOG_MAXIMUM_LEVEL_DEBUG=y
CONFIG_COMPILER_OPTIMIZATION_DEBUG=y
CONFIG_BOOTLOADER_LOG_LEVEL_DEBUG=y
```
