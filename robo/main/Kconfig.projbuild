## robo/main/Kconfig.projbuild
```kconfig
menu "Robot Configuration"

    choice ROBO_DISPLAY_TYPE
        prompt "Display type"
        default ROBO_DISPLAY_GC9A01
        help
            Select the physical display connected to the robot.

        config ROBO_DISPLAY_GC9A01
            bool "GC9A01 1.28\" round LCD (240x240, SPI)"
            help
                Round 240x240 RGB565 color LCD connected via SPI.
                Pins: SCLK=10, MOSI=11, CS=12, DC=13, RST=14, BL=21.

        config ROBO_DISPLAY_SSD1309
            bool "SSD1309 2.42\" OLED (128x64, I2C)"
            help
                Rectangular 128x64 monochrome OLED connected via I2C.
                Pins: SCL=10, SDA=11 (reuses SPI clock/data pins).

    endchoice

    choice ROBO_EYES_STYLE
        prompt "Eyes style"
        default ROBO_EYES_STYLE_SOLID
        help
            Select the visual style for the robot's animated eyes.

        config ROBO_EYES_STYLE_SOLID
            bool "Solid (no pupils)"
            help
                White shapes only — emotion conveyed through eye shape,
                eyelid position, and tilt. Simpler, Cozmo-like look.

        config ROBO_EYES_STYLE_PUPIL
            bool "With pupils"
            help
                Classic cartoon eyes with black pupils. Supports look
                direction (left/right/up/down) via pupil movement.

    endchoice

endmenu
```

## tower/main/Kconfig.projbuild
```kconfig
menu "Tower Configuration"

    choice TOWER_CAMERA_BOARD
        prompt "Camera board"
        default TOWER_CAMERA_FREENOVE_S3
        help
            Select your ESP32-S3 camera board to set correct GPIO pins.

        config TOWER_CAMERA_FREENOVE_S3
            bool "Freenove ESP32-S3 WROOM CAM"
            help
                Freenove ESP32-S3 board with OV2640.

        config TOWER_CAMERA_ESP32S3_EYE
            bool "ESP32-S3-EYE (Espressif)"
            help
                Espressif official AI dev board with OV2640.

        config TOWER_CAMERA_CUSTOM
            bool "Custom pin assignment"
            help
                Define your own camera GPIO pins below.

    endchoice

    config TOWER_NUM_SLOTS
        int "Number of block slots"
        default 8
        range 1 16
        help
            Number of block positions the camera reads from the board.

    config TOWER_LIGHT_GPIO
        int "LED lighting GPIO"
        default 4
        help
            GPIO for tower illumination LEDs (turn on before capture).

endmenu
```
